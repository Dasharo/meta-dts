## meta-dts-distro/conf/distro/dts-distro.conf
```bitbake
require conf/distro/poky.conf

DISTRO = "dts-distro"

# distro name
DISTRO_NAME = "Dasharo Tools Suite"
DISTRO_VERSION = "1.0.99-rc7"
SDK_VENDOR = "-dtssdk"

MAINTAINER = "3mdeb Sp. z o. o. <contact@3mdeb.com>"

TARGET_VENDOR = "-dts"

# distro features
# DISTRO_FEATURES_DEFAULT ?= "acl alsa argp bluetooth ext2 ipv4 ipv6 largefile pcmcia usbgadget usbhost wifi xattr nfs zeroconf pci 3g nfc x11 vfat"
# POKY_DEFAULT_DISTRO_FEATURES = "largefile opengl ptest multiarch wayland vulkan"
DISTRO_FEATURES = "${DISTRO_FEATURES_DEFAULT} systemd tpm tpm2"

# explictely use systemd and disable sysvinit completely
VIRTUAL-RUNTIME_init_manager = "systemd"
VIRTUAL-RUNTIME_initscripts = ""
VIRTUAL-RUNTIME_syslog = ""
DISTRO_FEATURES_BACKFILL_CONSIDERED += "sysvinit pulseaudio"
VIRTUAL-RUNTIME_vim = "vim"

ROOT_PASSWORD = "jlz9IbDJscvTcTjpDkk1xVoPZnxIm1K5"

WKS_FILES = "usb-stick-dts.wks.in"
IMAGE_FSTYPES = "cpio.gz wic.gz"

PREFERRED_VERSION_flashrom = "git"
PREFERRED_VERSION_fwupd = "2.0.1"
APPEND += "quiet"
```

## meta-dts-distro/conf/distro/dts-ost2-distro.conf
```bitbake
require dts-sb-distro.conf

APPEND:remove = "quiet"

UEFI_SELOADER = "1"
GRUB_SIGN_VERIFY = "0"

IMAGE_EFI_BOOT_FILES = " \
    grubenv;EFI/BOOT/ \
    grub.cfg;EFI/BOOT/ \
    efi-unsigned/*.efi;EFI/BOOT/ \
    efi-unsigned/x86_64-efi/*;EFI/BOOT/x86_64-efi/ \
"
```

## meta-dts-distro/conf/distro/dts-sb-distro.conf
```bitbake
require dts-distro.conf

# distro name
DISTRO_NAME = "Dasharo Tools Suite UEFI Secure Boot enabled"
DISTRO_VERSION = "9.9.9-rc"

# UEFI Secure Boot variables
# Use only UEFI Secure Boot without MOK Secure Boot
UEFI_SELOADER = "0"
GRUB_SIGN_VERIFY = "1"
UEFI_SB = "1"

IMAGE_EFI_BOOT_FILES = " \
  bootfiles/EFI/BOOT/password.inc*;EFI/BOOT/ \
  bootfiles/EFI/BOOT/grub*;EFI/BOOT/ \
  bootfiles/EFI/BOOT/grubx64.efi;EFI/BOOT/ \
  bootfiles/EFI/BOOT/efi*;EFI/BOOT/ \
  bootfiles/EFI/BOOT/boot*;EFI/BOOT/ \
  LockDown.efi*;EFI/BOOT/ \
  bootfiles/EFI/BOOT/x86_64-efi/*;EFI/BOOT/x86_64-efi/ \
  bzImage.sig \
  bootx64.efi;EFI/BOOT/ \
"

# we want that grub-efi from meta-efi-secure-boot installed bootfiles under
# /boot/EFI/BOOT
EFI_BOOT_PATH = "/boot/EFI/BOOT"

# TODO: because of problem with prefixes added in grub-efi recipe in
# meta-efi-secure-boot the iso target is unbuidable, this should be debugged and
# fixed
IMAGE_FSTYPES:remove = "iso"

INITRAMFS_IMAGE = "secure-core-image-initramfs"
DISTRO_FEATURES_NATIVE:append = " efi-secure-boot"
DISTRO_FEATURES:append = " efi-secure-boot modsign"
MACHINE_FEATURES_NATIVE:append = " efi"
MACHINE_FEATURES:append = " efi"

DEBUG_FLAGS:forcevariable = ""
IMAGE_INSTALL:append = " kernel-image-bzimage"

PREFERRED_VERSION_tpm2-tss-engine = "1.1.0"
```

## meta-dts-distro/conf/layer.conf
```bitbake
# We have a conf and classes directory, add to BBPATH
BBPATH .= ":${LAYERDIR}"

# We have recipes-* directories, add to BBFILES
BBFILES += "${LAYERDIR}/recipes-*/*/*.bb ${LAYERDIR}/recipes-*/*/*.bbappend"

BBFILE_COLLECTIONS += "dts-distro"
BBFILE_PATTERN_dts-distro = "^${LAYERDIR}/"
BBFILE_PRIORITY_dts-distro = "1"

# This should only be incremented on significant changes that will
# cause compatibility issues with other layers
LAYERVERSION_dts-distro = "1"

LAYERDEPENDS_dts-distro = " \
    core \
    openembedded-layer \
    "

LAYERSERIES_COMPAT_dts-distro = "scarthgap master"
```
